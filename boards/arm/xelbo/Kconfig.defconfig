## boards/arm/xelbo/Kconfig.defconfig
```kconfig
# SPDX-License-Identifier: MIT

if BOARD_XELBO

if USB_DEVICE_STACK

config USB_NRFX
    default y

endif # USB_DEVICE_STACK

config BT_CTLR
    default BT

config LED_STRIP_INIT_PRIORITY
    default 80

choice ZMK_BOOTMODE_MAGIC_VALUE_BOOTLOADER_TYPE
    default ZMK_BOOTMODE_MAGIC_VALUE_BOOTLOADER_TYPE_ADAFRUIT_NRF52
endchoice

endif
```

## boards/arm/xelbo/Kconfig.xelbo
```kconfig
# SPDX-License-Identifier: MIT

config BOARD_XELBO
    select SOC_NRF52833_QIAA
    imply RETAINED_MEM
    imply RETENTION
    imply RETENTION_BOOT_MODE

config XELBO_GPIO_LED_TO_WS2812
    bool "Forward GPIO LED state to the onboard WS2812"
    default y
    select LED_STRIP
    help
      Treat pins 0, 1, and 2 of the Xelbo virtual GPIO controller as
      red, green, and blue channels of the onboard WS2812 respectively.

      Disable this option to leave the virtual GPIO as a no-op controller.
      The WS2812 remains available as a normal LED strip when LED_STRIP is
      enabled by the application.

config XELBO_GPIO_LED_BRIGHTNESS
    int "WS2812 brightness for GPIO LED channels"
    default 16
    range 0 255
    depends on XELBO_GPIO_LED_TO_WS2812
    help
      RGB channel value used when a GPIO LED channel is on. A value of 0
      is off and 255 is the maximum brightness.

config XELBO_GPIO_LED_INIT_PRIORITY
    int
    default 85
```

## boards/arm/xelbo/board.yml
```yaml
board:
  name: xelbo
  vendor: sekigon
  socs:
    - name: nrf52833
  revision:
    format: major.minor.patch
    default: 1.0.0
    revisions:
      - name: 1.0.0
```

## boards/arm/xelbo/xelbo_defconfig
```kconfig
# SPDX-License-Identifier: MIT

# Enable MPU
CONFIG_ARM_MPU=y

CONFIG_PINCTRL=y

# enable GPIO
CONFIG_GPIO=y

CONFIG_USE_DT_CODE_PARTITION=y
CONFIG_BUILD_OUTPUT_UF2=y

CONFIG_MPU_ALLOW_FLASH_WRITE=y
CONFIG_NVS=y
CONFIG_SETTINGS_NVS=y
CONFIG_FLASH=y
CONFIG_FLASH_PAGE_LAYOUT=y
CONFIG_FLASH_MAP=y

CONFIG_CLOCK_CONTROL_NRF=y
CONFIG_CLOCK_CONTROL_NRF_K32SRC_RC=n
CONFIG_CLOCK_CONTROL_NRF_K32SRC_XTAL=y

CONFIG_ZMK_USB=y
CONFIG_ZMK_BLE=y

CONFIG_RETAINED_MEM=y
CONFIG_RETENTION=y
CONFIG_RETENTION_BOOT_MODE=y
CONFIG_ZMK_BOOTMODE_MAGIC_VALUE_BOOTLOADER_TYPE_ADAFRUIT_NRF52=y

CONFIG_ZMK_NON_LIPO_BATTERY_MANAGEMENT=y
```

## config/west.yml
```yaml
manifest:
  remotes:
    - name: sekigon-gonnoc
      url-base: https://github.com/sekigon-gonnoc
  projects:
    - name: zmk-feature-non-lipo-battery-management
      remote: sekigon-gonnoc
      revision: main
  self:
    path: config
```

## dts/bindings/gpio/zmk,ws2812-gpio.yaml
```yaml
description: GPIO-compatible RGB channel adapter for a WS2812 LED

compatible: "zmk,ws2812-gpio"

include: [gpio-controller.yaml]

properties:
  led-strip:
    type: phandle
    required: true
    description: WS2812 LED strip device driven by this adapter

  "#gpio-cells":
    const: 2

gpio-cells:
  - pin
  - flags
```
